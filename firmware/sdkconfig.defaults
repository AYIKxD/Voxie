## firmware/sdkconfig.defaults
```kconfig
# Voxie — ESP32-S3 sdkconfig defaults

# --- Target ---
CONFIG_IDF_TARGET="esp32s3"

# --- Flash ---
CONFIG_ESPTOOLPY_FLASHSIZE_8MB=y
CONFIG_ESPTOOLPY_FLASHMODE_QIO=y
CONFIG_ESPTOOLPY_FLASHFREQ_80M=y

# --- PSRAM ---
CONFIG_SPIRAM=y
CONFIG_SPIRAM_MODE_OCT=y
CONFIG_SPIRAM_SPEED_80M=y
CONFIG_SPIRAM_TRY_ALLOCATE_WIFI_LWIP=y

# --- Partition table ---
CONFIG_PARTITION_TABLE_CUSTOM=y
CONFIG_PARTITION_TABLE_CUSTOM_FILENAME="partitions/partitions.csv"

# --- FreeRTOS ---
CONFIG_FREERTOS_HZ=1000
CONFIG_FREERTOS_GENERATE_RUN_TIME_STATS=y
CONFIG_FREERTOS_USE_STATS_FORMATTING_FUNCTIONS=y

# --- Wi-Fi ---
CONFIG_ESP_WIFI_STATIC_RX_BUFFER_NUM=10
CONFIG_ESP_WIFI_DYNAMIC_RX_BUFFER_NUM=32
CONFIG_ESP_WIFI_DYNAMIC_TX_BUFFER_NUM=32

# --- LWIP ---
CONFIG_LWIP_MAX_SOCKETS=16

# --- SNTP ---
CONFIG_LWIP_SNTP_MAX_SERVERS=1

# --- WebSocket ---
CONFIG_WS_TRANSPORT=y
CONFIG_ESP_WEBSOCKET_CLIENT_ENABLE=y

# --- HTTP Server (for SoftAP provisioning) ---
CONFIG_HTTPD_MAX_REQ_HDR_LEN=1024

# --- OTA ---
CONFIG_BOOTLOADER_APP_ROLLBACK_ENABLE=y

# --- Logging ---
CONFIG_LOG_DEFAULT_LEVEL_INFO=y

# --- Task watchdog ---
CONFIG_ESP_TASK_WDT_TIMEOUT_S=15
```
